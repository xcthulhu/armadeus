## buildroot/package/games/quake-pak/Config.in
```kconfig
config BR2_PACKAGE_QUAKE_PAK
	bool "shareware Quake PAK/WAD file"
	depends on BR2_PACKAGE_SDLQUAKE
	help
	  This will install the shareware pak/wad data file for the Quake game.

	  The file will be placed in the /usr/share/games/quake/ directory.
```

## buildroot/package/games/sdlquake/Config.in
```kconfig
config BR2_PACKAGE_SDLQUAKE
	bool "sdlquake"
	select BR2_PACKAGE_SDL
	select BR2_PACKAGE_SDL_MIXER
	select BR2_PACKAGE_SDL_NET
	help
	  sdlquake is a port of ID Software's popular Quake 3-D shooter game.
	  (Not supported by ID Software)

	  http://www.libsdl.org/projects/quake/
```

## buildroot/package/gpm/Config.in
```kconfig
config BR2_PACKAGE_GPM
	bool "GPM Mouse server"
	default n
	help
	  GPM means general purpose mouse and is the mouse support for linux
	  in the console.
```

## buildroot/package/imxregs/Config.in
```kconfig
config BR2_PACKAGE_IMXREGS
	bool "imxregs"
	default n
	help
	  This debug tool allows you to access the i.MX internal registers 
	  directly from Linux userspace. (If operation was allowed in U-Boot).
```

## buildroot/package/lcd4linux/Config.in
```kconfig
config BR2_PACKAGE_LCD4LINUX
	bool "LCD4Linux daemon"
	select BR2_PACKAGE_NCURSES
	default n
	help
	  LCD4Linux allows you to show some system parameters on a textual LCD
	  connected to your Armadeus board.
```

## buildroot/package/lmbench/Config.in
```kconfig
config BR2_PACKAGE_LMBENCH
	bool "LMbench"
	select BR2_PACKAGE_MICROPERL
	default n
	help
	  Tools for Performance Analysis. Suite of simple, portable benchmarks.
	  http://www.bitmover.com/lmbench/
```

## buildroot/package/lua/Config.in
```kconfig
config BR2_PACKAGE_LUA
	bool "lua"
	default n
	select BR2_READLINE
	select BR2_PACKAGE_NCURSES
	help
	  Build Lua which is a powerful, fast, light-weight, embeddable scripting language.
	  http://www.lua.org/
```

## buildroot/package/max5821ctrl/Config.in
```kconfig
config BR2_PACKAGE_MAX5821CTRL
	bool "max5821ctrl"
	depends BR2_ARMADEUS_PACKAGE
	default y
	help
	  Build MAX5821 control tool. It allows you to set the I2C MAX5821 DAC directly 
	  from Linux userspace (command setDAC).
```

## buildroot/package/mesa/Config.in
```kconfig
config BR2_PACKAGE_MESALIB
	bool "Mesa library"
	default n
	select BR2_PACKAGE_GPM
	help
	  Build MesaGL. It allows you to use OpenGL on your Armadeus board.
```

## buildroot/package/prboom/Config.in
```kconfig
config BR2_PACKAGE_PRBOOM
	bool "PrBoom"
	select BR2_PACKAGE_SDL 
	select BR2_PACKAGE_SDL_MIXER
	select BR2_PACKAGE_SDL_NET
	default n
	help

	  PrBoom is the culmination of years of work by various people and projects on the Doom source code.

	  http://prboom.sourceforge.net/about.html
```

## buildroot/package/pymysql/Config.in
```kconfig
config BR2_PACKAGE_PYMYSQL
	depends on BR2_PACKAGE_PYTHON
	bool "MySQL support for Python"
	help
	  MySQLdb is an thread-compatible interface to the popular MySQL 
	  database server that provides the Python database API.

	  http://sourceforge.net/projects/mysql-python
```

## buildroot/package/pyserial/Config.in
```kconfig
config BR2_PACKAGE_PYSERIAL
	bool "pyserial"
	depends on BR2_PACKAGE_PYTHON
	default n
	help
		Installs the python pyserial extension
```

## buildroot/package/samba/Config.in
```kconfig
config BR2_PACKAGE_SAMBA
	bool "samba"
	default n
	help
	  Samba allows the interoperability between Linux/Unix servers 
	  and Windows-based clients.
	  http://www.samba.org/

config BR2_PACKAGE_SMBMOUNT
	bool "smbmount (660 Kb) service in target"
	default y
	depends on BR2_PACKAGE_SAMBA
	help
	  Put smbmount & smbumount service in the target. 
	  IMPORTANT:
	  Needs the mount command from utils-linux package  (not mount from the busybox)

config BR2_PACKAGE_SMBD
	bool "nmbd & smbd (3.1 Mb) service in target"
	default n
	depends on BR2_PACKAGE_SAMBA
	help
	  Put nmbd & smbd  service in the target.

config BR2_PACKAGE_SMB_START
	bool "add samba init script"
	default y
	depends on BR2_PACKAGE_SMBD
	help
	  Put smbd & nmbd intialization script in /etc/init.d.

config BR2_PACKAGE_SMBPASSWD
	bool "smbpasswd (1.2 Mb) service in target"
	default n
	depends on BR2_PACKAGE_SAMBA
	help
	  Put smbpasswd service in the target.
```

## buildroot/package/sdlwater/Config.in
```kconfig
config BR2_PACKAGE_SDL_WATER
	bool "SDL_water"
	select BR2_PACKAGE_SDL
	default n
	help

	  Water effect demo coded with SDL

	  http://www.libsdl.org/projects/SDL_water/
```

## buildroot/package/slideshow/Config.in
```kconfig
config BR2_PACKAGE_SLIDESHOW
	bool "Slideshow"
	depends on BR2_PACKAGE_SDL && BR2_PACKAGE_SDL_IMAGE
	default n
	help

	  Perigee Slideshow is a command line program that searches a directory for supported graphic files and displays them in a slideshow

	  http://www.xmission.com/~jstanley/slideshow.html
```

## buildroot/package/snes9x/Config.in
```kconfig
config BR2_PACKAGE_SNES9X
	bool "Snes9X"
	select BR2_PACKAGE_SDL
	default n
	help

	  Snes9x is a portable, freeware Super Nintendo Entertainment System
	  (SNES) emulator. It basically allows you to play most games designed
	  for the SNES and Super Famicom Nintendo game systems on your PC or
	  Workstation; which includes some real gems that were only ever
	  released in Japan.

          http://www.snes9x.com/
```

## buildroot/package/socketcan/Config.in
```kconfig
config BR2_PACKAGE_SOCKETCAN
	bool "Socket CAN"
	default n
	help
	  The socketcan package is an implementation of CAN protocols
	  (Controller Area Network) for Linux.  CAN is a networking technology
	  which has wide-spread use in automation, embedded devices, and
	  automotive fields.

	  While there have been other CAN implementations for Linux based on 
	  character devices, Socket CAN uses the Berkeley socket API, 
	  the Linux network stack and implements the CAN device drivers as 
	  network interfaces.  The CAN socket API has been designed as similar
	  as possible to the TCP/IP protocols to allow programmers, familiar 
	  with network programming, to easily learn how to use CAN sockets.

config BR2_PACKAGE_SOCKETCAN_TEST
        bool "install test tools"
        depends on BR2_PACKAGE_SOCKETCAN
        help
          Compile and install socketcan test tools too.
```

## buildroot/package/tslib/Config.in
```kconfig
config BR2_PACKAGE_TSLIB
	bool "tslib"
	select BR2_INSTALL_LIBSTDCPP
	default n
	help
		Tslib is an abstraction layer for touchscreen panel events.

		See: http://tslib.berlios.de/
```

## buildroot/package/xenomai/Config.in
```kconfig
config BR2_PACKAGE_XENOMAI
        bool "Xenomai"
	depends on BR2_LINUX_2_6_29 || BR2_LINUX_2_6_27 
	help
		Real-Time Framework for Linux

		http://xenomai.org
```

## buildroot/target/device/armadeus/Config.in
```kconfig
menuconfig BR2_TARGET_ARMADEUS
	bool "Armadeus Device Support"
	depends on BR2_arm
	help
	  Armadeus ARM based systems

if BR2_TARGET_ARMADEUS

config BR2_BOARD_NAME
	string "Board name"
	default "apf"

config BR2_BOARD_PATH
	string
	default "target/device/armadeus/$(BR2_BOARD_NAME)"

config BR2_CPU_NAME
	string "CPU name"
	default "imx"

config BR2_TARGET_ARMADEUS_NR_SDRAM
	string "Number of RAM chips on your board"
	default 1

config BR2_TARGET_ARMADEUS_SDRAM_SIZE
	string "Size of a single RAM chip (in MB)"
	default "64"
	help
	  Size of a single RAM chip on your board.

endif
```

## buildroot/target/device/armadeus/apf51/Config.in
```kconfig
if BR2_TARGET_ARMADEUS_APF51
choice
	prompt "Number of DDR2 RAM chips on your APF"
	default BR2_TARGET_ARMADEUS_APF51_NB_DDR2RAM_1
	help
	  Number of DDR2 RAM chips mounted on your APF51
	  (Default: 1)

config BR2_TARGET_ARMADEUS_APF51_NB_DDR2RAM_1
	bool "1x DDR2 RAM"
	help
	  1 DDR2 RAM chip (Default).

config BR2_TARGET_ARMADEUS_APF51_NB_DDR2RAM_2
	bool "2x DDR2 RAMs"
	help
	  2 DDR2 RAM chips.

endchoice

config BR2_TARGET_ARMADEUS_NR_SDRAM
	string
	default 1		if BR2_TARGET_ARMADEUS_APF51_NB_DDR2RAM_1
	default 2		if BR2_TARGET_ARMADEUS_APF51_NB_DDR2RAM_2

choice
	prompt "Single size of your DDR2 RAM chip(s)"
	default BR2_TARGET_ARMADEUS_APF51_DDR2RAM_128
	help
	  DDR2 RAM size per chip (Default 128MB).

config BR2_TARGET_ARMADEUS_APF51_DDR2RAM_32
	bool "32MB"
	help
	  32MB size per DDR2 RAM chip.

config BR2_TARGET_ARMADEUS_APF51_DDR2RAM_64
	bool "64MB"
	help
	  64MB size per DDR2 RAM chip.

config BR2_TARGET_ARMADEUS_APF51_DDR2RAM_128
	bool "128MB"
	help
	  128MB size per DDR2 RAM chip.

config BR2_TARGET_ARMADEUS_APF51_DDR2RAM_256
	bool "256MB"
	help
	  256MB size per DDR2 RAM chip.

endchoice

endif
```

## buildroot/target/device/armadeus/apf9328/Config.in
```kconfig
if BR2_TARGET_ARMADEUS_APF9328

choice
	prompt "Target SDRAM size"
	default BR2_TARGET_ARMADEUS_SDRAM_16 if BR2_TARGET_ARMADEUS_APF9328
	depends on BR2_TARGET_ARMADEUS_APF9328
	help
	  Target SDRAM size (Default 16MB).

config BR2_TARGET_ARMADEUS_SDRAM_8
	depends on BR2_TARGET_ARMADEUS_APF9328
	bool "8MB"
	help
	  Target 8MB SDRAM size.

config BR2_TARGET_ARMADEUS_SDRAM_16
	depends on BR2_TARGET_ARMADEUS_APF9328
	bool "16MB"
	help
	  Target 16MB SDRAM size (Default).

config BR2_TARGET_ARMADEUS_SDRAM_32
	depends on BR2_TARGET_ARMADEUS_APF9328
	bool "32MB"
	help
	  Target 32MB SDRAM size.

config BR2_TARGET_ARMADEUS_SDRAM_64
	depends on BR2_TARGET_ARMADEUS_APF9328
	bool "64MB"
	help
	  Target 64MB SDRAM size.

endchoice

endif
```

## buildroot/target/device/armadeus/pps/Config.in
```kconfig
if BR2_TARGET_ARMADEUS_APF27_PPS
choice
	prompt "Target DDR SDRAM chip size"
	default BR2_TARGET_ARMADEUS_APF27_SDRAM_64 if BR2_TARGET_ARMADEUS_APF27_PPS
	depends on BR2_TARGET_ARMADEUS_APF27_PPS
	help
	  Target DDR SDRAM size per chip (Default 64MB).

config BR2_TARGET_ARMADEUS_APF27_SDRAM_16
	depends on BR2_TARGET_ARMADEUS_APF27_PPS
	bool "16MB"
	help
	  Target 16MB DDR SDRAM size per chip.

config BR2_TARGET_ARMADEUS_APF27_SDRAM_32
	depends on BR2_TARGET_ARMADEUS_APF27_PPS
	bool "32MB"
	help
	  Target 32MB DDR SDRAM size per chip.

config BR2_TARGET_ARMADEUS_APF27_SDRAM_64
	depends on BR2_TARGET_ARMADEUS_APF27_PPS
	bool "64MB"
	help
	  Target 64MB DDR SDRAM size per chip (Default).

config BR2_TARGET_ARMADEUS_APF27_SDRAM_128
	depends on BR2_TARGET_ARMADEUS_APF27_PPS
	bool "128MB"
	help
	  Target 128MB DDR SDRAM size per chip).

config BR2_TARGET_ARMADEUS_APF27_SDRAM_256
	depends on BR2_TARGET_ARMADEUS_APF27_PPS
	bool "256MB"
	help
	  Target 256MB DDR SDRAM size per chip.

endchoice

choice
	prompt "Target Number of DDR SDRAM chip"
	default BR2_TARGET_ARMADEUS_NR_SDRAM_1
	help
	  Number of DDR SDRAM chip present on target (1 or 2)
	  (Default 1 DDR SDRAM)

config BR2_TARGET_ARMADEUS_NR_SDRAM_1
	depends on BR2_TARGET_ARMADEUS_APF27_PPS
	bool "1 DDR SDRAM"
	help
	  1 DDR SDRAM on target (Default).
config BR2_TARGET_ARMADEUS_NR_SDRAM_2
	depends on BR2_TARGET_ARMADEUS_APF27_PPS
	bool "2 DDR SDRAMs"
	help
	  2 DDR SDRAMs on target.

endchoice

config BR2_TARGET_ARMADEUS_NR_SDRAM
	string
	default 1		if BR2_TARGET_ARMADEUS_NR_SDRAM_1
	default 2		if BR2_TARGET_ARMADEUS_NR_SDRAM_2

endif
```

## software/buildroot/package/fbset/Config.in
```kconfig
config BR2_PACKAGE_FBSET
	bool "fbset utility"
	default n
	help
	  Build framebuffer fbset utility
```

## software/buildroot/package/imxregs/Config.in
```kconfig
config BR2_PACKAGE_IMXREGS
	bool "imxregs"
	default n
	help
	  Build imxregs debug tool. It allows you to show the iMX internal registers content directly from Linux userspace.
```
