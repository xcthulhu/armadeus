## buildroot/package/ad9889ctrl/Config.in
```kconfig
config BR2_PACKAGE_AD9889CTRL
	bool "ad9889ctrl"
	depends on BR2_TARGET_ARMADEUS
	default n
	help
	  Build AD9889 control tool. It allows you to configure the HDMI/DVI
	  output of the DevFull directly from Linux userspace (command ad9889).
```

## buildroot/package/allegro/Config.in
```kconfig
config BR2_PACKAGE_ALLEGRO
	bool "Allegro"
	default n
	help
	
	Allegro is a game programming library for C/C++ developers 
	distributed freely and supporting the following platforms:
	DOS, Unix (Linux, FreeBSD, Irix, Solaris, Darwin), Windows, QNX, 
	BeOS and MacOS X. 
	It provides many functions for graphics, sounds, player input 
	(keyboard, mouse and joystick) and timers. It also provides fixed and
	floating point mathematical functions, 3d functions, file management 
	functions, compressed datafile and a GUI.

	  http://alleg.sourceforge.net/
```

## buildroot/package/alsa-driver/Config.in
```kconfig
config BR2_PACKAGE_ALSA_DRIVER
	bool "alsa-driver"
	default n
	help
	  Advanced Linux Sound Architecture

	  http://www.alsa-project.org/
```

## buildroot/package/armadeus-testsuite/Config.in
```kconfig
config BR2_PACKAGE_ARMADEUS_TESTS
	bool "Armadeus Test Suite"
	default n
	help
	  Install Armadeus "Test Suite" to allow automatic release validation.
	  Test scripts will be installed on the APF in /usr/bin/test/ .
```

## buildroot/package/armadeus/Config.in
```kconfig
menu "Armadeus specific tools/utilities"

source package/armadeus/ad9889ctrl/Config.in
source package/armadeus/as_devices/Config.in
source package/armadeus/ch7024ctrl/Config.in
source package/armadeus/demos/Config.in
source package/armadeus/imxssi/Config.in
source package/armadeus/max5821ctrl/Config.in
source package/armadeus/testsuite/Config.in

endmenu
```

## buildroot/package/armadeus/ad9889ctrl/Config.in
```kconfig
config BR2_PACKAGE_AD9889CTRL
	bool "ad9889 control"
	depends on BR2_TARGET_ARMADEUS
	help
	  Build "ad9889" control tool. It allows you to configure the HDMI/DVI
	  output of the APF27DevFull directly from Linux userspace.
```

## buildroot/package/armadeus/as_devices/Config.in
```kconfig
config BR2_PACKAGE_AS_DEVICES
	bool "as_devices"
	depends on BR2_TARGET_ARMADEUS
	help
          Library that drives armadeus specific devices.

config BR2_PACKAGE_AS_DEVICES_TESTS
	bool "as_device test"
	depends on BR2_PACKAGE_AS_DEVICES
	help
	  Executable that can test all as_devices

config BR2_PACKAGE_AS_DEVICES_CPP
    depends on BR2_PACKAGE_AS_DEVICES
    bool "wrapper C++"
    default n
    help
        C++ wrapper for as_devices library

config BR2_PACKAGE_AS_DEVICES_TESTS_CPP
	bool "as_device C++ wrappers test"
	depends on BR2_PACKAGE_AS_DEVICES_CPP
	help
	  Executable that can test as_devices C++ wrappers

config BR2_PACKAGE_AS_DEVICES_PYTHON
	depends on BR2_PACKAGE_AS_DEVICES
	depends on BR2_PACKAGE_PYTHON
	bool "Python wrapper"
	help
	  Python wrapper for as_devices library. needs python.
```

## buildroot/package/armadeus/ch7024ctrl/Config.in
```kconfig
config BR2_PACKAGE_CH7024CTRL
	bool "ch7024 control"
	depends on BR2_TARGET_ARMADEUS
	help
	  Build "ch7024" control tool. It allows you to configure the S-Video
	  output of the APF9328DevFull directly from Linux userspace.
```

## buildroot/package/armadeus/demos/Config.in
```kconfig
config BR2_PACKAGE_ARMADEUS_DEMOS
	bool "Armadeus misc demos"
	default n
	help
	  Install Armadeus miscallenous demos.

menu "Choose the demos to install"
	depends on BR2_PACKAGE_ARMADEUS_DEMOS

config BR2_PACKAGE_ARMADEUS_DEMOS_ARMANOID
	bool "Armanoid"
	select BR2_PACKAGE_SDL
	help
	  Small game to show SDL usage.

config BR2_PACKAGE_ARMADEUS_DEMOS_BACKLIGHT
	bool "Backlight control"
	select BR2_PACKAGE_SDL
	help
	  SDL tool to graphically adjust LCD backlight.

config BR2_PACKAGE_ARMADEUS_DEMOS_GPIO
	bool "GPIO test"

config BR2_PACKAGE_ARMADEUS_DEMOS_GPS
	bool "GPS frame decoding"
	help
	  Small tool to show how to read and decode NMEA frames
	  coming from a serial GPS.

config BR2_PACKAGE_ARMADEUS_DEMOS_INPUT
	bool "Input test"
	select BR2_PACKAGE_SDL
	help

config BR2_PACKAGE_ARMADEUS_DEMOS_MUSIC_PLAYER
	bool "Music player"
	select BR2_PACKAGE_SDL
	select BR2_PACKAGE_SDL_TTF
	select BR2_PACKAGE_SDL_MIXER
	help
	  SDL based music player.

config BR2_PACKAGE_ARMADEUS_DEMOS_CAPTURE
	bool "Camera capture"
	select BR2_PACKAGE_SDL
	help
        capture and print camera video stream.

config BR2_PACKAGE_ARMADEUS_DEMOS_OSCILLO
	bool "Oscilloscope"
	help
	  MAX1027 data viewer "à la" oscilloscope. (Work in progress).

config BR2_PACKAGE_ARMADEUS_DEMOS_SHOW_IMAGE
	bool "Image viewer"
	select BR2_PACKAGE_SDL_IMAGE
	help
	  SDL based image viewer.

config BR2_PACKAGE_ARMADEUS_DEMOS_TEST_LCD
	bool "LCD test"
	select BR2_PACKAGE_SDL
	help
	  Test for LCD dead pixels. Needs SDL.

config BR2_PACKAGE_ARMADEUS_DEMOS_MCP25020
	bool "DEMOS_MCP25020"
        depends on BR2_PACKAGE_SOCKETCAN
	help
	  Test for CAN bus communication with MCP25020.
          Requires socket CAN.

comment "DEMOS_MCP25020 requires socket CAN"
	depends on !BR2_PACKAGE_SOCKETCAN

endmenu
```

## buildroot/package/armadeus/fpgaregs/Config.in
```kconfig
config BR2_PACKAGE_FPGAREGS
	bool "fpgaregs"
	default n
	help
	  This debug tool allows you to access the FPGA internal registers
	  of Armadeus boards, directly from Linux userspace.
```

## buildroot/package/armadeus/imxregs/Config.in
```kconfig
config BR2_PACKAGE_IMXREGS
	bool "imxregs"
	help
	  This debug tool allows you to access the i.MX internal registers 
	  directly from Linux userspace. (If operation was allowed in U-Boot).
```

## buildroot/package/armadeus/imxssi/Config.in
```kconfig
config BR2_PACKAGE_IMXSSI
	bool "imxssi"
	default n
	help
	  Build imxssi debug tool.
	  It allows you to send a basic audio signal to the tsc2102
	  audio codec.
```

## buildroot/package/armadeus/max5821ctrl/Config.in
```kconfig
config BR2_PACKAGE_MAX5821CTRL
	bool "max5821 control (setDAC)"
	help
	  This tool allows you to configure the MAX5821 I2C DAC directly 
	  from Linux userspace ("setDAC" command) on your APF9328DevFull or
	  on your APF27DevFull.
```

## buildroot/package/armadeus/pps/Config.in
```kconfig
config BR2_PACKAGE_ARMADEUS_PPS_UTILITIES
	bool "PPS Utilities"
	help
	  Install PPS utilities & initialization scripts needed for:
	    - GPIOs initialization
	    - Guest user creation to connect to PPS via SSH

if BR2_PACKAGE_ARMADEUS_PPS_UTILITIES

config BR2_PACKAGE_ARMADEUS_PPS_TEST_SCRIPTS
	bool "PPS Test scripts"
	help
	  Install PPS test scripts for Ethernet, WiFi & USB Gadget.
	  Scripts will be installed in /usr/local/pps/scripts.

endif
```

## buildroot/package/armadeus/rxtx/Config.in
```kconfig
config BR2_PACKAGE_RXTX
    bool "rxtx"
    depends on BR2_PACKAGE_CLASSPATH
    help
        RXTX is a Java library, providing serial and parallel communication.

        RXTX is a Java library, using a native implementation (via JNI),
	providing serial and parallel communication for the Java Development
	Toolkit (JDK).


        http://rxtx.qbang.org
```

## buildroot/package/armadeus/tfp410ctrl/Config.in
```kconfig
config BR2_PACKAGE_TFP410CTRL
	bool "tfp410ctrl"
	depends on BR2_TARGET_ARMADEUS
	help
	  Build "tfp410ctrl" tool. It allows you to configure the HDMI/DVI
	  output of the APF51Dev directly from Linux userspace.
```

## buildroot/package/as_devices/Config.in
```kconfig
config BR2_PACKAGE_AS_DEVICES
	bool "as_devices"
	depends on BR2_TARGET_ARMADEUS
	default n
	help
        library that drive armadeus specific devices
config BR2_PACKAGE_AS_DEVICES_CPP
    depends on BR2_PACKAGE_AS_DEVICES
    bool "wrapper C++"
    default n
    help
        C++ wrapper for as_devices library

config BR2_PACKAGE_AS_DEVICES_PYTHON
    depends on BR2_PACKAGE_AS_DEVICES
    bool "wrapper Python"
    default n
    help
        Python wrapper for as_devices library
```

## buildroot/package/bluez/Config.in
```kconfig
config BR2_PACKAGE_BLUEZ
	bool "bluez"
	default n
	depends on BR2_PACKAGE_DBUS
	select BR2_PACKAGE_PKGCONFIG
	help
	  Install the bluez package

comment "bluez not available (need dbus)"
        depends on !BR2_PACKAGE_DBUS
```

## buildroot/package/bluez3/Config.in
```kconfig
config BR2_PACKAGE_BLUEZ_LIBS
	bool "bluez"
	select BR2_PACKAGE_PKGCONFIG
	help
	  Install the bluez library

config BR2_PACKAGE_BLUEZ_UTILS
	bool "bluez-utils"
	default n
	depends on BR2_PACKAGE_DBUS
	select BR2_PACKAGE_BLUEZ_LIBS
	help
	  Install the bluez utilities

comment "bluez-utils not available (need dbus)"
        depends on !BR2_PACKAGE_DBUS
```

## buildroot/package/ch7024ctrl/Config.in
```kconfig
config BR2_PACKAGE_CH7024CTRL
	bool "ch7024ctrl"
	depends BR2_ARMADEUS_PACKAGE
	default n
	help
	  Build CH7024 control tool. It allows you to configure the Svideo output of the DevFull directly 
	  from Linux userspace (command ch7024).
```

## buildroot/package/fbgrab/Config.in
```kconfig
config BR2_PACKAGE_FBGRAB
	bool "fbgrab"
	default n
	help
	FBGrab is a framebuffer screenshot program, 
	capturing the linux framebuffer and converting 
	it to a png-picture.

	http://hem.bredband.net/gmogmo/fbgrab/
```

## buildroot/package/fbtest/Config.in
```kconfig
config BR2_PACKAGE_FBTEST
	bool "fbtest"
	help
	  Fbtest is a collection of tests for the frame buffer device. 
	  All tests are gathered inside the same executable.

	  http://linux-fbdev.cvs.sourceforge.net/viewvc/linux-fbdev/FBdev/utlilities/fbtest/
```

## buildroot/package/fpgaregs/Config.in
```kconfig
config BR2_PACKAGE_FPGAREGS
	bool "fpgaregs"
	default n
	help
	  Build fpgaregs debug tool. It allows you to access the FPGA internal registers content directly from Linux userspace.
```
