## target/linux/modules/generic/Kconfig
```kconfig
#
#

config ARMADEUS_GENERIC_DRIVER
        tristate "Generic Armadeus driver (for test)"
        default n
        depends on ARMADEUS_DRIVERS
        ---help---
		  Could be useful as startpoint for your own drivers
```

## target/linux/modules/gpio/Kconfig
```kconfig
#
#

config ARMADEUS_GPIO_DRIVER
        tristate "Armadeus GPIO driver"
        default n
        depends on ARMADEUS_DRIVERS
        ---help---

config ARMADEUS_PPDEV_DRIVER
        tristate "Armadeus Parallel Port emulation driver (with LCD port)"
        default n
        depends on ARMADEUS_GPIO_DRIVER && MACH_APF9328
        ---help---
          This driver allows you to emulate a parallel port interface with GPIO.
          Activate it if you want for example connect a LCD with a // port interface.
```

## target/linux/modules/isp1761/Kconfig
```kconfig
#
#

config ARMADEUS_ISP1761
        tristate "isp1761 USB 2.0 Host controller"
        default n
        depends on ARMADEUS_DRIVERS && USB
        ---help---
        This driver allows you to control isp1761 USB 2.0 Host controller of the DevFull board
```

## target/linux/modules/keypad/Kconfig
```kconfig
#

#
config ARMADEUS_KEYPAD_DRIVER
        tristate "Armadeus keypad driver"
        default n
        depends on ARMADEUS_DRIVERS
        ---help---
	  GPIO pins can be used to control a matrix keypad with this driver
```

## target/linux/modules/led/Kconfig
```kconfig
#
#

config ARMADEUS_LED_DRIVER
        tristate "Led driver"
        default n
        depends on ARMADEUS_DRIVERS
        ---help---
```

## target/linux/modules/max1027/Kconfig
```kconfig
#
#

config ARMADEUS_MAX1027
        tristate "Armadeus Max1027 ADC driver (fast version)"
        default n
        depends on ARMADEUS_DRIVERS
        ---help---
	  Max1027 fast driver
```

## target/linux/modules/max9768/Kconfig
```kconfig
#
#

config ARMADEUS_MAX9768
	tristate "MAX9768 Audio amplifier"
	default n
	depends on ARMADEUS_DRIVERS
	---help---
	  Custom Armadeus driver for MAX9768 Audio amplifier driver.
	  (To wait until we are Asoc compatible)
```

## target/linux/modules/pwm/Kconfig
```kconfig
#
#

config ARMADEUS_PWM_DRIVER
        tristate "Armadeus PWM driver"
        default n
        depends on ARMADEUS_DRIVERS
        ---help---
	  This driver allows you to control the PWM controller in the i.MXl.
	  PWM is useful to play sound or control motors
```
