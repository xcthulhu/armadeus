## software/buildroot/package/qte_gpl/Config.in
```kconfig
config BR2_PACKAGE_QTE_GPL
	bool "Qt/Embedded (GPL version)"
	default n
	select BR2_INSTALL_LIBSTDCPP
	select BR2_PTHREADS_NATIVE
	select BR2_PACKAGE_JPEG
	select BR2_PACKAGE_LIBPNG
	select BR2_PACKAGE_E2FSPROGS
	help
	  Trolltech's Qt/Embedded GPL edition and Opie.
          Offers the same APIs used in building desktop applications tailored to a smaller footprint.

	  http://trolltech.com/

	  Only tested with threading on, PACKAGE_JPEG, PACKAGE_LIBPNG, but remove those if you like.

choice
        prompt "Qt/Embedded Version"
        default BR2_QTE_GPL_VERSION_2_3_10
	depends BR2_PACKAGE_QTE_GPL
        help
          Select which version of Qt/Embedded you wish to use.

#        config BR2_QTE_VERSION_2_3_8
#                bool "Qt/E 2.3.8"

#        config BR2_QTE_VERSION_2_3_9
#                bool "Qt/E 2.3.9"

        config BR2_QTE_GPL_VERSION_2_3_10
                bool "Qt/E 2.3.10"

#        config BR2_QTE_VERSION_2_3_11
#                bool "Qt/E 2.3.11"

	config BR2_QTE_GPL_VERSION_4_0_1
		bool "Qt/E 4.0.1"
endchoice

config BR2_QTE_GPL_VERSION
        string
	default "2.3.8"		if BR2_QTE_GPL_VERSION_2_3_8
	default "2.3.9"		if BR2_QTE_GPL_VERSION_2_3_9
	default "2.3.10"	if BR2_QTE_GPL_VERSION_2_3_10
	default "2.3.11"	if BR2_QTE_GPL_VERSION_2_3_11
	default "4.0.1"		if BR2_QTE_GPL_VERSION_4_0_1

config BR2_PACKAGE_QTE_GPL_QVFB
	bool "QVfb"
	default y
	depends BR2_PACKAGE_QTE_GPL
	help
	  Trolltech provides a Virtual Framebuffer used to simulate the embedded device during development.
	  If you activate it, you will have all you need to test your Qt/E code on your host developmen system.

	  http://trolltech.com/

choice
        prompt "QVfb Version"
        default BR2_QTE_GPL_QVFB_VERSION_2_3_2
	depends BR2_PACKAGE_QTE_GPL_QVFB
        help
          Select the version of QVfb you wish to use.

        config BR2_QTE_GPL_QVFB_VERSION_2_3_2
                bool "QVfb 2.3.2"

        config BR2_QTE_GPL_QVFB_VERSION_2_3_9
                bool "QVfb 2.3.9"

endchoice

config BR2_QTE_GPL_QVFB_VERSION
        string
	default "2.3.2"		if BR2_QTE_GPL_QVFB_VERSION_2_3_2
	default "2.3.9"		if BR2_QTE_GPL_QVFB_VERSION_2_3_9



config BR2_PACKAGE_QTE_GPL_OPIE
	bool "Opie"
	default n
	depends BR2_PACKAGE_QTE_GPL
	help
	  Open Palmtop Integrated Environment aka Opie

          Opie is a completely Open Source based graphical user environment for PDAs and other devices running Linux.
	  http://opie.handhelds.org/

choice
        prompt "Opie Version"
        default BR2_QTE_GPL_OPIE_VERSION_1_2_0
	depends BR2_PACKAGE_QTE_GPL_OPIE
        help
          Select the version of Opie you wish to use.

        config BR2_QTE_GPL_OPIE_VERSION_1_0_3
                bool "Opie 1.0.3"
        config BR2_QTE_GPL_OPIE_VERSION_1_2_0
                bool "Opie 1.2.0"

endchoice

config BR2_QTE_GPL_OPIE_VERSION
        string
	default "1.0.3"		if BR2_QTE_GPL_OPIE_VERSION_1_0_3
	default "1.2.0"		if BR2_QTE_GPL_OPIE_VERSION_1_2_0

config BR2_QTE_GPL_TMAKE_VERSION
        string
	default "1.13"

choice
	prompt "Install directory for Qt/E"
	default BR2_QTE_GPL_TARGET_DIR
	depends BR2_PACKAGE_QTE_GPL
	help
	  Choose installation directory for Qt/E library

	config BR2_QTE_GPL_TARGET_DIR
		bool "Target rootfs"
	config BR2_QTE_GPL_NFS_DIR
		bool "Host nfs export dir"
endchoice

config BR2_QTE_GPL_LIB_INSTALL_DIR
	string "Install dir name (a /lib dir will be created)"
	default "/usr" 		if BR2_QTE_GPL_TARGET_DIR
	default "/local/export" if BR2_QTE_GPL_NFS_DIR

# generated from:
# ls ~/src/buildroot/build_arm/qt-2.3.10/configs/*-static|cut -c56-|sed -e 's/-static//g'|\
#   awk '{BR="BR2_QTE_CROSS_"toupper($1); gsub("-","_",BR); gsub("+","P",BR); printf"\tconfig %s\n\t\tbool \"%s\"\n\n",BR,$1}'

choice
        prompt "Qt/E Cross-Compiler Target Platform"
        default BR2_QTE_CROSS_LINUX_ARM_GPP
	depends BR2_PACKAGE_QTE_GPL
        help
          Select the Qt cross-platform string for your build

	config BR2_QTE_CROSS_CYGWIN_ARM_GPP
		# qtopia-phone does not have this platform in qtopia-phone-2.1.1/src/libraries/qtopia/custom-cygwin-arm-g++.{cpp,h}
		depends !BR2_PACKAGE_QTE_QTOPIA
		bool "cygwin-arm-g++"

	config BR2_QTE_CROSS_CYGWIN_IPAQ_GPP
		# qtopia-phone does not have this platform in qtopia-phone-2.1.1/src/libraries/qtopia/custom-cygwin-ipaq-g++.{cpp,h}
		depends !BR2_PACKAGE_QTE_QTOPIA
		bool "cygwin-ipaq-g++"

	config BR2_QTE_CROSS_CYGWIN_SHARP_GPP
		# qtopia-phone does not have this platform in qtopia-phone-2.1.1/src/libraries/qtopia/custom-cygwin-sharp-g++.{cpp,h}
		depends !BR2_PACKAGE_QTE_QTOPIA
		bool "cygwin-sharp-g++"

	config BR2_QTE_CROSS_FREEBSD_GPP
		# qtopia-phone does not have this platform in qtopia-phone-2.1.1/src/libraries/qtopia/custom-freebsd-g++.{cpp,h}
		depends !BR2_PACKAGE_QTE_QTOPIA
		bool "freebsd-g++"

	config BR2_QTE_CROSS_LINUX_ARM_GPP
		# qtopia-phone does not have this platform in qtopia-phone-2.1.1/src/libraries/qtopia/custom-linux-arm-g++.{cpp,h}
		depends !BR2_PACKAGE_QTE_QTOPIA
		bool "linux-arm-g++"

	config BR2_QTE_CROSS_LINUX_CASSIOPEIA_GPP
		bool "linux-cassiopeia-g++"

	config BR2_QTE_CROSS_LINUX_GENERIC_GPP
		bool "linux-generic-g++"

	config BR2_QTE_CROSS_LINUX_INNOVATOR_GPP
		bool "linux-innovator-g++"

	config BR2_QTE_CROSS_LINUX_IPAQ_GPP
		bool "linux-ipaq-g++"

	config BR2_QTE_CROSS_LINUX_KOALA_GPP
		# qtopia-phone does not have this platform in qtopia-phone-2.1.1/src/libraries/qtopia/custom-linux-koala-g++.{cpp,h}
		depends !BR2_PACKAGE_QTE_QTOPIA
		bool "linux-koala-g++"

	config BR2_QTE_CROSS_LINUX_MIPS_GPP
		# qtopia-phone does not have this platform in qtopia-phone-2.1.1/src/libraries/qtopia/custom-linux-mips-g++.{cpp,h}
		depends !BR2_PACKAGE_QTE_QTOPIA
		bool "linux-mips-g++"

	config BR2_QTE_CROSS_LINUX_SH3_GPP
		# qtopia-phone does not have this platform in qtopia-phone-2.1.1/src/libraries/qtopia/custom-linux-sh3-g++.{cpp,h}
		depends !BR2_PACKAGE_QTE_QTOPIA
		bool "linux-sh3-g++"

	config BR2_QTE_CROSS_LINUX_SHARP_GPP
		bool "linux-sharp-g++"

	config BR2_QTE_CROSS_LINUX_X86_GPP
		bool "linux-x86-g++"

	config BR2_QTE_CROSS_QNX_RTP_GPP
		# qtopia-phone does not have this platform in qtopia-phone-2.1.1/src/libraries/qtopia/custom-qnx-rtp-g++.{cpp,h}
		depends !BR2_PACKAGE_QTE_QTOPIA
		bool "qnx-rtp-g++"

	config BR2_QTE_CROSS_SOLARIS_GPP
		# qtopia-phone does not have this platform in qtopia-phone-2.1.1/src/libraries/qtopia/custom-solaris-g++.{cpp,h}
		depends !BR2_PACKAGE_QTE_QTOPIA
		bool "solaris-g++"

	config BR2_QTE_CROSS_WIN32_MSVC
		# qtopia-phone does not have this platform in qtopia-phone-2.1.1/src/libraries/qtopia/custom-win32-msvc.{cpp,h}
		depends !BR2_PACKAGE_QTE_QTOPIA
		bool "win32-msvc"

endchoice

config BR2_QTE_CROSS_PLATFORM
        string
# generated from:
# ls ~/src/buildroot/build_arm/qt-2.3.10/configs/*-static|cut -c56-|sed -e 's/-static//g'|\
#   awk '{BR="BR2_QTE_CROSS_"toupper($1); gsub("-","_",BR); gsub("+","P",BR); printf"\tdefault \"%s\"\tif %s\n",$1,BR}'
	default "cygwin-arm-g++"	if BR2_QTE_CROSS_CYGWIN_ARM_GPP
	default "cygwin-ipaq-g++"	if BR2_QTE_CROSS_CYGWIN_IPAQ_GPP
	default "cygwin-sharp-g++"	if BR2_QTE_CROSS_CYGWIN_SHARP_GPP
	default "freebsd-g++"	if BR2_QTE_CROSS_FREEBSD_GPP
	default "linux-arm-g++"	if BR2_QTE_CROSS_LINUX_ARM_GPP
	default "linux-cassiopeia-g++"	if BR2_QTE_CROSS_LINUX_CASSIOPEIA_GPP
	default "linux-generic-g++"	if BR2_QTE_CROSS_LINUX_GENERIC_GPP
	default "linux-innovator-g++"	if BR2_QTE_CROSS_LINUX_INNOVATOR_GPP
	default "linux-ipaq-g++"	if BR2_QTE_CROSS_LINUX_IPAQ_GPP
	default "linux-koala-g++"	if BR2_QTE_CROSS_LINUX_KOALA_GPP
	default "linux-mips-g++"	if BR2_QTE_CROSS_LINUX_MIPS_GPP
	default "linux-sh3-g++"	if BR2_QTE_CROSS_LINUX_SH3_GPP
	default "linux-sharp-g++"	if BR2_QTE_CROSS_LINUX_SHARP_GPP
	default "linux-x86-g++"	if BR2_QTE_CROSS_LINUX_X86_GPP
	default "qnx-rtp-g++"	if BR2_QTE_CROSS_QNX_RTP_GPP
	default "solaris-g++"	if BR2_QTE_CROSS_SOLARIS_GPP
	default "win32-msvc"	if BR2_QTE_CROSS_WIN32_MSVC
```

## software/buildroot/target/device/armadeus/Config.in
```kconfig
comment "Armadeus project Specific Device Support"
	depends BR2_arm

config BR2_TARGET_ARMADEUS
	bool "Board support for the Armadeus development boards"
	depends BR2_arm
	default n
	help
	  Armadeus arm based systems


choice
	prompt "Armadeus target device"
	default BR2_TARGET_ARMADEUS_APF9328
	depends on BR2_TARGET_ARMADEUS
	help
	  Armadeus target device 

config BR2_TARGET_ARMADEUS_APF9328
	bool "apf9328"
config BR2_TARGET_ARMADEUS_APM9328
	bool "apm9328"
endchoice


config BR2_TARGET_ARMADEUS_NAME
	string
	default "apm9328"	if BR2_TARGET_ARMADEUS_APM9328
	default "apf9328"	if BR2_TARGET_ARMADEUS_APF9328

choice
	prompt "Target SDRAM size"
	default BR2_TARGET_ARMADEUS_SDRAM_32
	depends on BR2_TARGET_ARMADEUS_APF9328 || BR2_TARGET_ARMADEUS_APM9328
	help
	  Target SDRAM size 

config BR2_TARGET_ARMADEUS_SDRAM_8
	bool "8MB"
config BR2_TARGET_ARMADEUS_SDRAM_16
	bool "16MB"
config BR2_TARGET_ARMADEUS_SDRAM_32
	bool "32MB"
config BR2_TARGET_ARMADEUS_SDRAM_64
	bool "64MB"
endchoice

config BR2_TARGET_ARMADEUS_SDRAM_SIZE
	string
	default "8"		if BR2_TARGET_ARMADEUS_SDRAM_8
	default "16"		if BR2_TARGET_ARMADEUS_SDRAM_16
	default "32"		if BR2_TARGET_ARMADEUS_SDRAM_32
	default "64"		if BR2_TARGET_ARMADEUS_SDRAM_64


comment "Package support"
	depends BR2_TARGET_ARMADEUS

config BR2_PACKAGE_LINUX
	bool "linux"
	default n
	depends BR2_TARGET_ARMADEUS
	select BR2_TARGET_U-BOOT
	help
	    The Linux kernel.
	    http://www.kernel.org/

config BR2_TARGET_U-BOOT
	bool "U-Boot"
	default n
	depends BR2_TARGET_ARMADEUS
	help
	  The U-Boot universal bootloader for embedded systems.
```

## target/linux/modules/Kconfig
```kconfig
#
# Armadeus custom drivers configuration
#

menu "Armadeus specific drivers"

#
config ARMADEUS_DRIVERS
	boolean "Support for specific Armadeus drivers"
	default n
	---help---

comment "Misc."
	depends on ARMADEUS_DRIVERS
	  
source "drivers/armadeus/generic/Kconfig"

source "drivers/armadeus/gpio/Kconfig"

source "drivers/armadeus/imxlkeypad/Kconfig"

source "drivers/armadeus/max1027/Kconfig"

source "drivers/armadeus/max9768/Kconfig"

comment "FPGA related"
	depends on ARMADEUS_DRIVERS

source "drivers/armadeus/fpga/Kconfig"

comment "Handheld related"
	depends on ARMADEUS_DRIVERS

source "drivers/armadeus/pwm/Kconfig"

source "drivers/armadeus/backlight/Kconfig"

comment "Communication bus related"
	depends on ARMADEUS_DRIVERS

source "drivers/armadeus/isp1761/Kconfig"

endmenu
```

## target/linux/modules/as1531_platform/Kconfig
```kconfig
#
#

config ARMADEUS_AS1531_PLAT
	tristate "AS1531 platform data"
	default n
	depends on ARMADEUS_DRIVERS
	select SENSORS_AS1531
	---help---
	  Specific platform data for as1531 plugged on apf27-Dev board
	  on SPI3.
```

## target/linux/modules/backlight/Kconfig
```kconfig
#
#

config IMX_BACKLIGHT
        tristate "i.MX backlight driver"
        default n
        depends on ARMADEUS_DRIVERS && BACKLIGHT_LCD_SUPPORT
        ---help---
        This driver allows you to control the backlight of your graphic LCD, if it's
        connected to the i.MXL/i.MX27 "CONTRAST" pin.
```

## target/linux/modules/display/Kconfig
```kconfig
#
#

config HX5116_DISPLAY
        tristate "HX5116 AMOLED display driver"
        default n
        depends on ARMADEUS_DRIVERS
        select DISPLAY_SUPPORT
        ---help---
        This driver allows you to control the contrast of 
        HX5116 based AMOLED screen.
```

## target/linux/modules/fpga/Kconfig
```kconfig
#
# Armadeus custom drivers configuration
#

menu "FPGA Drivers "

#
config ARMADEUS_FPGA_DRIVERS
	boolean "Support FPGA specific drivers"
	default n
	---help---
	All drivers for FPGA components
	
source "drivers/armadeus/fpga/dev_tools/Kconfig"

source "drivers/armadeus/fpga/others/Kconfig"

endmenu
```

## target/linux/modules/fpga/POD/Kconfig
```kconfig
#
# Armadeus custom drivers configuration
#
#
                     
#
config POD_DRIVERS
    tristate "Drivers generated by POD"
    default n                               
    depends on ARMADEUS_FPGA_DRIVERS
    ---help---
    All drivers for FPGA components
```

## target/linux/modules/fpga/POD/void/Kconfig
```kconfig
#
#

config VOID_DRIVER
        tristate "Useless, just to avoid error"
        default n
        depends on POD_DRIVERS 
        ---help---
        Useless, just to avoid error
```

## target/linux/modules/fpga/Wb_button/Kconfig
```kconfig
#
#

config ARMADEUS_BUTTON_DRIVER
        tristate "Wishbone Button driver"
        default n
        depends on ARMADEUS_FPGA_DRIVERS
        ---help---
```

## target/linux/modules/fpga/Wb_led/Kconfig
```kconfig
#
#

config ARMADEUS_LED_DRIVER
        tristate "Wishbone Led driver"
        default n
        depends on ARMADEUS_FPGA_DRIVERS
        ---help---
```

## target/linux/modules/fpga/dev_tools/Kconfig
```kconfig
#
# FPGA devt drivers configuration
#

comment "Drivers for configuring and testing the FPGA"
	depends on ARMADEUS_FPGA_DRIVERS
	
source "drivers/armadeus/fpga/dev_tools/loader/Kconfig"
```

## target/linux/modules/fpga/dev_tools/loader/Kconfig
```kconfig
#

#
config ARMADEUS_FPGA_LOADER_DRIVER
        tristate "Armadeus FPGA configuration driver (= loader)"
        default n
        depends on ARMADEUS_FPGA_DRIVERS
        ---help---
	  With this driver you will be able to (re)load the configuration
	  of your FPGA directly from Linux userspace.
```

## target/linux/modules/fpga/fpga_devtools/Kconfig
```kconfig
#

#
config ARMADEUS_FPGA_TOOL_DRIVER
        tristate "Armadeus FPGA configuration driver"
        default n
        depends on ARMADEUS_FPGA_DRIVERS
        ---help---
```

## target/linux/modules/fpga/fpgaaccess/Kconfig
```kconfig
#
#

config ARMADEUS_FPGAACCESS_DRIVER
        tristate "fpgaaccess driver"
        default n
        depends on ARMADEUS_FPGA_DRIVERS
        ---help---
```

## target/linux/modules/fpga/irq_manager/Kconfig
```kconfig
#
#

config ARMADEUS_FPGA_IRQ_MANAGER
        tristate "OpenCore IRQ manager driver"
        default n
        depends on ARMADEUS_FPGA_DRIVERS
        ---help---
	  You need it if you have a POD generated "IP"
```

## target/linux/modules/fpga/others/Kconfig
```kconfig
#
# Armadeus custom drivers configuration
#
#

comment "Others drivers for the FPGA"
	depends on ARMADEUS_FPGA_DRIVERS
	
source "drivers/armadeus/fpga/others/i2ctest/Kconfig"
source "drivers/armadeus/fpga/others/ps2keyboard/Kconfig"
```

## target/linux/modules/fpga/others/i2ctest/Kconfig
```kconfig
#
#

config ARMADEUS_I2C_OCORE_IRQMNG
        tristate "Driver for testing wishbone i2c-ocore-irq_mng"
        default n
        depends on ARMADEUS_FPGA_DRIVERS
        ---help---
```

## target/linux/modules/fpga/ps2keyboard/Kconfig
```kconfig
#
#

config ARMADEUS_PS2KBD_DRIVER
        tristate "Armadeus PS/2 driver"
        default n
        depends on ARMADEUS_FPGA_DRIVERS
        ---help---
	  If you have the corresponding IP loaded in the FPGA then this
	  driver will allow you to use PS/2 keyboard with your Armadeus
	  board.
```

## target/linux/modules/fpga/serial/Kconfig
```kconfig
#
#

config ARMADEUS_FPGA_16550_OCORE
        tristate "OpenCore 16550 serial IP driver"
        default n
        depends on ARMADEUS_FPGA_DRIVERS
        ---help---
	  If you have the corresponding IP loaded in the FPGA then this
	  driver will allow you to use it by registering the serial ports
	  to the Linux 8250 serial layer.
```
