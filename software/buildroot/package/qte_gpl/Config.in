## target/linux/modules/fpga/wishbone_example/Kconfig
```kconfig
#
# Armadeus custom drivers configuration
#
#
                     
#
config ARMADEUS_WISHBONE_EXAMPLE_DRIVERS
    boolean "Drivers for wishbone example"
    default n                               
    depends on ARMADEUS_FPGA_DRIVERS
    ---help---
    Drivers used for wishbone example design that can be
    found in firmware/wishbone_example/

source "drivers/armadeus/fpga/wishbone_example/wb_button/Kconfig"
source "drivers/armadeus/fpga/wishbone_example/wb_led/Kconfig"
source "drivers/armadeus/fpga/wishbone_example/wb_irq_mngr/Kconfig"
```

## target/linux/modules/fpga/wishbone_example/wb_button/Kconfig
```kconfig
#
#

config ARMADEUS_WISHBONE_EXAMPLE_BUTTON_DRIVER
        tristate "Wishbone Button driver"
        default m
        depends on ARMADEUS_WISHBONE_EXAMPLE_DRIVERS
        ---help---
```

## target/linux/modules/fpga/wishbone_example/wb_irq_mngr/Kconfig
```kconfig
#
# Armadeus custom drivers configuration
#
#
                     
#
config ARMADEUS_WISHBONE_EXAMPLE_IRQ_MNGR_DRIVER
    tristate "IRQ manager with wishbone interface"
    default m
    depends on ARMADEUS_WISHBONE_EXAMPLE_DRIVERS
    ---help---
```

## target/linux/modules/fpga/wishbone_example/wb_led/Kconfig
```kconfig
#
#

config ARMADEUS_WISHBONE_EXAMPLE_LED_DRIVER
        tristate "Wishbone Led driver"
        default m
        depends on ARMADEUS_WISHBONE_EXAMPLE_DRIVERS
        ---help---
        blink a led
```

## target/linux/modules/fpga_devtools/Kconfig
```kconfig
#

#
config ARMADEUS_FPGA_TOOL_DRIVER
        boolean "Armadeus FPGA configuration driver"
        default n
        depends on ARMADEUS_DRIVERS
        ---help---
```
