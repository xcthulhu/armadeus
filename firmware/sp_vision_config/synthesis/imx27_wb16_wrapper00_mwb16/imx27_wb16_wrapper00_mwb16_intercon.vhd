---------------------------------------------------------------------------
-- Company     : Automaticaly generated by POD
-- Author(s)   : 
-- 
-- Creation Date : 2010-10-21
-- File          : imx27_wb16_wrapper00_mwb16.vhd
--
-- Abstract : 
-- Connect slaves to mwb16 from imx27_wb16_wrapper00
--
---------------------------------------------------------------------------

library IEEE;
use IEEE.STD_LOGIC_1164.ALL;
use IEEE.numeric_std.all;

Entity imx27_wb16_wrapper00_mwb16 is
    port
    (

        -- spartanconf_wbs connection
        spartanconf_wbs_add                      : out  std_logic_vector(1 downto 0);
        spartanconf_wbs_writedata                : out  std_logic_vector(15 downto 0);
        spartanconf_wbs_readdata                 : in   std_logic_vector(15 downto 0);
        spartanconf_wbs_strobe                   : out  std_logic;
        spartanconf_wbs_cycle                    : out  std_logic;
        spartanconf_wbs_write                    : out  std_logic;
        spartanconf_wbs_ack                      : in   std_logic;

        -- spartanconf_candr connection
        spartanconf_clk                          : out  std_logic;
        spartanconf_reset                        : out  std_logic;

        -- imx27_wb16_wrapper00_mwb16 connection
        imx27_wb16_wrapper00_wbm_address         : in   std_logic_vector(12 downto 0);
        imx27_wb16_wrapper00_wbm_readdata        : out  std_logic_vector(15 downto 0);
        imx27_wb16_wrapper00_wbm_writedata       : in   std_logic_vector(15 downto 0);
        imx27_wb16_wrapper00_wbm_strobe          : in   std_logic;
        imx27_wb16_wrapper00_wbm_write           : in   std_logic;
        imx27_wb16_wrapper00_wbm_ack             : out  std_logic;
        imx27_wb16_wrapper00_wbm_cycle           : in   std_logic;

        -- imx27_wb16_wrapper00_candr connection
        imx27_wb16_wrapper00_gls_reset           : out  std_logic;
        imx27_wb16_wrapper00_gls_clk             : out  std_logic;

        -- rstgen_syscon00_imx27_wb16_wrapper00 connection
        rstgen_syscon00_gls_clk                  : in   std_logic;
        rstgen_syscon00_gls_reset                : in   std_logic
    );
end entity;

architecture imx27_wb16_wrapper00_mwb16_1 of imx27_wb16_wrapper00_mwb16 is
    signal spartanconf_wbs_cs                       : std_logic := '0' ;
begin

    -- Clock and Reset connection
    spartanconf_clk                          <= rstgen_syscon00_gls_clk;
    spartanconf_reset                        <= rstgen_syscon00_gls_reset;

    imx27_wb16_wrapper00_gls_reset           <= rstgen_syscon00_gls_reset;
    imx27_wb16_wrapper00_gls_clk             <= rstgen_syscon00_gls_clk;


    -- Address decoding  --
    -----------------------
    spartanconf_wbs_add <= imx27_wb16_wrapper00_wbm_address(2 downto 1);

    decodeproc : process(rstgen_syscon00_gls_clk,rstgen_syscon00_gls_reset,imx27_wb16_wrapper00_wbm_address)
    begin
        if rstgen_syscon00_gls_reset='1' then
            spartanconf_wbs_cs <= '0';
        elsif rising_edge(rstgen_syscon00_gls_clk) then

            if imx27_wb16_wrapper00_wbm_address(12 downto 3)="0000000000" and imx27_wb16_wrapper00_wbm_strobe='1' then
                spartanconf_wbs_cs <= '1';
            else
                spartanconf_wbs_cs <= '0';
            end if;

        end if;
    end process decodeproc;

    -----------------------------
    -- Control signals to slave
    -----------------------------

    -- for spartanconf
    spartanconf_wbs_strobe <= (imx27_wb16_wrapper00_wbm_strobe and spartanconf_wbs_cs );
    spartanconf_wbs_cycle <= (imx27_wb16_wrapper00_wbm_cycle and spartanconf_wbs_cs );
    spartanconf_wbs_write <= (imx27_wb16_wrapper00_wbm_write and spartanconf_wbs_cs );
    spartanconf_wbs_writedata <= imx27_wb16_wrapper00_wbm_writedata when (imx27_wb16_wrapper00_wbm_write and spartanconf_wbs_cs ) = '1' else (others => '0');


    -------------------------------
    -- Control signal for master --
    -------------------------------
    imx27_wb16_wrapper00_wbm_readdata <=  spartanconf_wbs_readdata when spartanconf_wbs_cs='1' else
                                       (others => '0');
    imx27_wb16_wrapper00_wbm_ack <=  (spartanconf_wbs_ack and spartanconf_wbs_cs);

end architecture imx27_wb16_wrapper00_mwb16_1;
