---------------------------------------------------------------------------
-- Company     : Automaticaly generated by POD
-- Author(s)   : 
--
-- Creation Date : 2011-05-03
-- File          : imx51_wb16_wrapper00_mwb16.vhd
--
-- Abstract :
-- Connect slaves to mwb16 from imx51_wb16_wrapper00
--
---------------------------------------------------------------------------

library IEEE;
use IEEE.STD_LOGIC_1164.ALL;
use IEEE.numeric_std.all;

Entity imx51_wb16_wrapper00_mwb16 is
    port
    (

        -- irq_mngr00_swb16 connection
        irq_mngr00_wbs_s1_address                : out  std_logic_vector(1 downto 0);
        irq_mngr00_wbs_s1_readdata               : in   std_logic_vector(15 downto 0);
        irq_mngr00_wbs_s1_writedata              : out  std_logic_vector(15 downto 0);
        irq_mngr00_wbs_s1_ack                    : in   std_logic;
        irq_mngr00_wbs_s1_strobe                 : out  std_logic;
        irq_mngr00_wbs_s1_cycle                  : out  std_logic;
        irq_mngr00_wbs_s1_write                  : out  std_logic;

        -- irq_mngr00_candr connection
        irq_mngr00_gls_clk                       : out  std_logic;
        irq_mngr00_gls_reset                     : out  std_logic;

        -- led00_swb16 connection
        led00_wbs_add                            : out  std_logic;
        led00_wbs_writedata                      : out  std_logic_vector(15 downto 0);
        led00_wbs_readdata                       : in   std_logic_vector(15 downto 0);
        led00_wbs_strobe                         : out  std_logic;
        led00_wbs_cycle                          : out  std_logic;
        led00_wbs_write                          : out  std_logic;
        led00_wbs_ack                            : in   std_logic;

        -- led00_candr connection
        led00_gls_reset                          : out  std_logic;
        led00_gls_clk                            : out  std_logic;

        -- button00_swb16 connection
        button00_wbs_add                         : out  std_logic;
        button00_wbs_readdata                    : in   std_logic_vector(15 downto 0);
        button00_wbs_strobe                      : out  std_logic;
        button00_wbs_write                       : out  std_logic;
        button00_wbs_ack                         : in   std_logic;
        button00_wbs_cycle                       : out  std_logic;

        -- button00_candr connection
        button00_gls_reset                       : out  std_logic;
        button00_gls_clk                         : out  std_logic;

        -- imx51_wb16_wrapper00_mwb16 connection
        imx51_wb16_wrapper00_wbm_address         : in   std_logic_vector(15 downto 0);
        imx51_wb16_wrapper00_wbm_readdata        : out  std_logic_vector(15 downto 0);
        imx51_wb16_wrapper00_wbm_writedata       : in   std_logic_vector(15 downto 0);
        imx51_wb16_wrapper00_wbm_strobe          : in   std_logic;
        imx51_wb16_wrapper00_wbm_write           : in   std_logic;
        imx51_wb16_wrapper00_wbm_ack             : out  std_logic;
        imx51_wb16_wrapper00_wbm_cycle           : in   std_logic;

        -- imx51_wb16_wrapper00_candr connection
        imx51_wb16_wrapper00_gls_reset           : out  std_logic;
        imx51_wb16_wrapper00_gls_clk             : out  std_logic;

        -- rstgen_syscon00_imx51_wb16_wrapper00 connection
        rstgen_syscon00_gls_clk                  : in   std_logic;
        rstgen_syscon00_gls_reset                : in   std_logic
    );
end entity;

architecture imx51_wb16_wrapper00_mwb16_1 of imx51_wb16_wrapper00_mwb16 is
    signal irq_mngr00_swb16_cs                      : std_logic := '0' ;
    signal led00_swb16_cs                           : std_logic := '0' ;
    signal button00_swb16_cs                        : std_logic := '0' ;
begin

    -- Clock and Reset connection
    irq_mngr00_gls_clk                       <= rstgen_syscon00_gls_clk;
    irq_mngr00_gls_reset                     <= rstgen_syscon00_gls_reset;

    led00_gls_reset                          <= rstgen_syscon00_gls_reset;
    led00_gls_clk                            <= rstgen_syscon00_gls_clk;

    button00_gls_reset                       <= rstgen_syscon00_gls_reset;
    button00_gls_clk                         <= rstgen_syscon00_gls_clk;

    imx51_wb16_wrapper00_gls_reset           <= rstgen_syscon00_gls_reset;
    imx51_wb16_wrapper00_gls_clk             <= rstgen_syscon00_gls_clk;


    -- Address decoding  --
    -----------------------
    irq_mngr00_wbs_s1_address <= imx51_wb16_wrapper00_wbm_address(2 downto 1);
    led00_wbs_add <= imx51_wb16_wrapper00_wbm_address(1);
    button00_wbs_add <= imx51_wb16_wrapper00_wbm_address(1);

    decodeproc : process(rstgen_syscon00_gls_clk,rstgen_syscon00_gls_reset,imx51_wb16_wrapper00_wbm_address)
    begin
        if rstgen_syscon00_gls_reset='1' then
            irq_mngr00_swb16_cs <= '0';
            led00_swb16_cs <= '0';
            button00_swb16_cs <= '0';
        elsif rising_edge(rstgen_syscon00_gls_clk) then

            if imx51_wb16_wrapper00_wbm_address(15 downto 3)="0000000000000" and imx51_wb16_wrapper00_wbm_strobe='1' then
                irq_mngr00_swb16_cs <= '1';
            else
                irq_mngr00_swb16_cs <= '0';
            end if;

            if imx51_wb16_wrapper00_wbm_address(15 downto 2)="00000000000010" and imx51_wb16_wrapper00_wbm_strobe='1' then
                led00_swb16_cs <= '1';
            else
                led00_swb16_cs <= '0';
            end if;

            if imx51_wb16_wrapper00_wbm_address(15 downto 2)="00000000000011" and imx51_wb16_wrapper00_wbm_strobe='1' then
                button00_swb16_cs <= '1';
            else
                button00_swb16_cs <= '0';
            end if;

        end if;
    end process decodeproc;

    -----------------------------
    -- Control signals to slave
    -----------------------------

    -- for irq_mngr00
    irq_mngr00_wbs_s1_strobe <= (imx51_wb16_wrapper00_wbm_strobe and irq_mngr00_swb16_cs );
    irq_mngr00_wbs_s1_cycle <= (imx51_wb16_wrapper00_wbm_cycle and irq_mngr00_swb16_cs );
    irq_mngr00_wbs_s1_write <= (imx51_wb16_wrapper00_wbm_write and irq_mngr00_swb16_cs );
    irq_mngr00_wbs_s1_writedata <= imx51_wb16_wrapper00_wbm_writedata when (imx51_wb16_wrapper00_wbm_write and irq_mngr00_swb16_cs ) = '1' else (others => '0');

    -- for led00
    led00_wbs_strobe <= (imx51_wb16_wrapper00_wbm_strobe and led00_swb16_cs );
    led00_wbs_cycle <= (imx51_wb16_wrapper00_wbm_cycle and led00_swb16_cs );
    led00_wbs_write <= (imx51_wb16_wrapper00_wbm_write and led00_swb16_cs );
    led00_wbs_writedata <= imx51_wb16_wrapper00_wbm_writedata when (imx51_wb16_wrapper00_wbm_write and led00_swb16_cs ) = '1' else (others => '0');

    -- for button00
    button00_wbs_strobe <= (imx51_wb16_wrapper00_wbm_strobe and button00_swb16_cs );
    button00_wbs_cycle <= (imx51_wb16_wrapper00_wbm_cycle and button00_swb16_cs );
    button00_wbs_write <= '0';


    -------------------------------
    -- Control signal for master --
    -------------------------------
    imx51_wb16_wrapper00_wbm_readdata <=  irq_mngr00_wbs_s1_readdata when irq_mngr00_swb16_cs='1' else
                                       led00_wbs_readdata when led00_swb16_cs='1' else
                                       button00_wbs_readdata when button00_swb16_cs='1' else
                                       (others => '0');
    imx51_wb16_wrapper00_wbm_ack <=  (irq_mngr00_wbs_s1_ack and irq_mngr00_swb16_cs)
                                    or 
                                (led00_wbs_ack and led00_swb16_cs)
                                    or 
                                (button00_wbs_ack and button00_swb16_cs);

end architecture imx51_wb16_wrapper00_mwb16_1;
