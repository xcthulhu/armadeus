---------------------------------------------------------------------------
-- Company     : Automaticaly generated by POD
-- Author(s)   : 
-- 
-- Creation Date : 2009-03-03
-- File          : Top_wishbone_example_tb.vhd
--
-- Abstract : 
-- insert a description here
--
---------------------------------------------------------------------------

library IEEE;
use IEEE.STD_LOGIC_1164.ALL;
use IEEE.numeric_std.all;

-- 
--                 Defines communication functions between imx and fpga:
--     
--                 write procedures
--                 procedure imx_write
--                 Params :
--                    address      : Write address 
--                    value        : value to write 
--                    gls_clk      : clock signal
--                    imx_cs_n     : Chip select 
--                    imx_oe_n     : Read signal
--                    imx_eb3_n    : Write signal
--                    imx_address  : Address signal
--                    imx_data     : Data signal
--                    WSC          : Value of imx WSC (see MC9328MXLRM.pdf p169) for sync=0
--     
--                 read procedures
--                 procedure imx_read
--                 Params :
--                    address      : Write address 
--                    value        : value returned
--                    gls_clk      : clock signal
--                    imx_cs_n     : Chip select 
--                    imx_oe_n     : Read signal
--                    imx_eb3_n    : Write signal
--                    imx_address  : Address signal
--                    imx_data     : Data signal
--                    WSC          : Value of imx WSC (see MC9328MXLRM.pdf p169) for sync=0
--                 
use work.apf_test_pkg.all;

entity top_wishbone_example_tb is
end entity top_wishbone_example_tb;

architecture RTL of top_wishbone_example_tb is

    CONSTANT HALF_PERIODE : time := 5.20833333333 ns;  -- Half clock period
    CONSTANT IRQ_MASK : std_logic_vector := x"0000";
    CONSTANT IRQ_PEND : std_logic_vector := x"0002";
    CONSTANT IRQ_MNGR00_ID : std_logic_vector := x"0004";
    CONSTANT LED_REG : std_logic_vector := x"0008";
    CONSTANT LED0_ID : std_logic_vector := x"000a";
    CONSTANT BUTTON0_ID : std_logic_vector := x"000c";
    CONSTANT BUTTON_REG : std_logic_vector := x"000e";
    signal  imx9328_wb16_wrapper00_imx_data :  std_logic_vector(15 downto 0);
    signal  imx9328_wb16_wrapper00_imx_address :  std_logic_vector(11 downto 0);
    signal  rstgen_syscon00_ext_clk :  std_logic;
    signal  imx9328_wb16_wrapper00_imx_cs_n :  std_logic;
    signal  imx9328_wb16_wrapper00_imx_eb3_n :  std_logic;
    signal  imx9328_wb16_wrapper00_imx_oe_n :  std_logic;
    signal  irq_mngr00_gls_irq :  std_logic;
    signal  led0_led :  std_logic;
    signal  button0_button :  std_logic;

    component top_wishbone_example
    port (        
        imx9328_wb16_wrapper00_imx_data    : inout std_logic_vector(15 downto 0);
        imx9328_wb16_wrapper00_imx_address : in std_logic_vector(11 downto 0);
        rstgen_syscon00_ext_clk            : in std_logic;
        imx9328_wb16_wrapper00_imx_cs_n    : in std_logic;
        imx9328_wb16_wrapper00_imx_eb3_n   : in std_logic;
        imx9328_wb16_wrapper00_imx_oe_n    : in std_logic;
        irq_mngr00_gls_irq : out std_logic;
        led0_led           : out std_logic;
        button0_button     : in std_logic
    );
    end component top_wishbone_example;

    signal value : std_logic_vector (15 downto 0);

begin

    top : top_wishbone_example
    port map(
        imx9328_wb16_wrapper00_imx_data => imx9328_wb16_wrapper00_imx_data,
        imx9328_wb16_wrapper00_imx_address => imx9328_wb16_wrapper00_imx_address,
        rstgen_syscon00_ext_clk => rstgen_syscon00_ext_clk,
        imx9328_wb16_wrapper00_imx_cs_n => imx9328_wb16_wrapper00_imx_cs_n,
        imx9328_wb16_wrapper00_imx_eb3_n => imx9328_wb16_wrapper00_imx_eb3_n,
        imx9328_wb16_wrapper00_imx_oe_n => imx9328_wb16_wrapper00_imx_oe_n,
        irq_mngr00_gls_irq => irq_mngr00_gls_irq,
        led0_led => led0_led,
        button0_button => button0_button
    );

     -- test read/write
    stimulus : process
    begin
        imx9328_wb16_wrapper00_imx_oe_n <= '1';
        imx9328_wb16_wrapper00_imx_eb3_n <= '1';
        imx9328_wb16_wrapper00_imx_cs_n <= '1';
        imx9328_wb16_wrapper00_imx_address <= (others => 'Z');
        imx9328_wb16_wrapper00_imx_data  <= (others => 'Z');
        button0_button <= '0';

        wait for HALF_PERIODE*10;

        -- reset irq_pend
        imx_write(IRQ_PEND,x"0000",
        rstgen_syscon00_ext_clk,imx9328_wb16_wrapper00_imx_cs_n,
        imx9328_wb16_wrapper00_imx_oe_n, imx9328_wb16_wrapper00_imx_eb3_n,
        imx9328_wb16_wrapper00_imx_address(11 downto 0),imx9328_wb16_wrapper00_imx_data,
        4);
        -- write on irq_mask
        imx_write(IRQ_MASK,x"ffff",
        rstgen_syscon00_ext_clk,imx9328_wb16_wrapper00_imx_cs_n,
        imx9328_wb16_wrapper00_imx_oe_n, imx9328_wb16_wrapper00_imx_eb3_n,
        imx9328_wb16_wrapper00_imx_address(11 downto 0),imx9328_wb16_wrapper00_imx_data,
        4);
        -- read led value
        imx_read(LED_REG,value,
        rstgen_syscon00_ext_clk,imx9328_wb16_wrapper00_imx_cs_n,
        imx9328_wb16_wrapper00_imx_oe_n, imx9328_wb16_wrapper00_imx_eb3_n,
        imx9328_wb16_wrapper00_imx_address(11 downto 0),imx9328_wb16_wrapper00_imx_data,
        4);
        assert value(0) = '0' report "Wrong led value" severity error;

        -- push button
        button0_button <= '1';
        wait for HALF_PERIODE*20;
        assert irq_mngr00_gls_irq = '1' report "IRQ not raised" severity error;
        -- read button value
        imx_read(BUTTON_REG,value,
        rstgen_syscon00_ext_clk,imx9328_wb16_wrapper00_imx_cs_n,
        imx9328_wb16_wrapper00_imx_oe_n, imx9328_wb16_wrapper00_imx_eb3_n,
        imx9328_wb16_wrapper00_imx_address(11 downto 0),imx9328_wb16_wrapper00_imx_data,
        4);
        assert value(0) = '1' report  "Failed to read button" severity error;

        -- Read irq pending
        imx_read(IRQ_PEND,value,
        rstgen_syscon00_ext_clk,imx9328_wb16_wrapper00_imx_cs_n,
        imx9328_wb16_wrapper00_imx_oe_n, imx9328_wb16_wrapper00_imx_eb3_n,
        imx9328_wb16_wrapper00_imx_address(11 downto 0),imx9328_wb16_wrapper00_imx_data,
        4);
        assert value(0) = '1' report "IRQ pending error" severity error;
        -- Acknowledge irq
        imx_write(IRQ_PEND,x"ffff",
        rstgen_syscon00_ext_clk,imx9328_wb16_wrapper00_imx_cs_n,
        imx9328_wb16_wrapper00_imx_oe_n, imx9328_wb16_wrapper00_imx_eb3_n,
        imx9328_wb16_wrapper00_imx_address(11 downto 0),imx9328_wb16_wrapper00_imx_data,
        4);
        imx_read(IRQ_PEND,value,
        rstgen_syscon00_ext_clk,imx9328_wb16_wrapper00_imx_cs_n,
        imx9328_wb16_wrapper00_imx_oe_n, imx9328_wb16_wrapper00_imx_eb3_n,
        imx9328_wb16_wrapper00_imx_address(11 downto 0),imx9328_wb16_wrapper00_imx_data,
        4);
        assert value(0) = '0' report "Acknowledge error" severity error;

        -- release button0_button
        button0_button <= '0';
        wait for HALF_PERIODE*20;
        -- Acknowledge irq
        imx_write(IRQ_PEND,x"ffff",
        rstgen_syscon00_ext_clk,imx9328_wb16_wrapper00_imx_cs_n,
        imx9328_wb16_wrapper00_imx_oe_n, imx9328_wb16_wrapper00_imx_eb3_n,
        imx9328_wb16_wrapper00_imx_address(11 downto 0),imx9328_wb16_wrapper00_imx_data,
        4);
        imx_read(IRQ_PEND,value,
        rstgen_syscon00_ext_clk,imx9328_wb16_wrapper00_imx_cs_n,
        imx9328_wb16_wrapper00_imx_oe_n, imx9328_wb16_wrapper00_imx_eb3_n,
        imx9328_wb16_wrapper00_imx_address(11 downto 0),imx9328_wb16_wrapper00_imx_data,
        4);
        --read button value
        imx_read(BUTTON_REG,value,
        rstgen_syscon00_ext_clk,imx9328_wb16_wrapper00_imx_cs_n,
        imx9328_wb16_wrapper00_imx_oe_n, imx9328_wb16_wrapper00_imx_eb3_n,
        imx9328_wb16_wrapper00_imx_address(11 downto 0),imx9328_wb16_wrapper00_imx_data,
        4);
        assert value(0) = '0' report "Low read button error" severity error;

        wait for HALF_PERIODE*10;
        assert false report "End of test" severity error;
    end process stimulus;        

   
    clockp : process
    begin
        rstgen_syscon00_ext_clk <= '1';
        wait for HALF_PERIODE;
        rstgen_syscon00_ext_clk <= '0';
        wait for HALF_PERIODE;
    end process clockp;

end architecture RTL;
